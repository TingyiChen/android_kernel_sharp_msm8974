## drivers/mmc/Kconfig
```kconfig
#
# MMC subsystem configuration
#

menuconfig MMC
	tristate "MMC/SD/SDIO card support"
	depends on HAS_IOMEM
	help
	  This selects MultiMediaCard, Secure Digital and Secure
	  Digital I/O support.

	  If you want MMC/SD/SDIO support, you should say Y here and
	  also to your specific host controller driver.

config MMC_DEBUG
	bool "MMC debugging"
	depends on MMC != n
	help
	  This is an option for use by developers; most people should
	  say N here.  This enables MMC core and driver debugging.

config MMC_PERF_PROFILING
	bool "MMC performance profiling"
	depends on MMC != n
	default n
	help
	  If you say Y here, support will be added for collecting
	  performance numbers at the MMC Queue and Host layers.

config MMC_CUST_SH
	bool "SHARP MMC driver customized"
	depends on MMC
	default n

config MMC_SD_CUST_SH
	bool "SHARP SD driver customized"
	depends on MMC_CUST_SH
	default n

config MMC_SD_PENDING_RESUME_CUST_SH
	bool "SHARP SD pending resume customized"
	depends on MMC_SD_CUST_SH
	default n

config MMC_SDIO_CUST_SH
	bool "SHARP SDIO driver customized"
	depends on MMC_CUST_SH
	default n

config ERR_RETRY_MMC_CUST_SH
	bool "SHARP MMC error retry customized"
	depends on MMC_CUST_SH
	default n

config CLOCKTIME_MMC_CUST_SH
	bool "SHARP MMC clocktime customized"
	depends on MMC_CUST_SH
	default n

config USE_QOS_WITH_TIMEOUT_MMC_CUST_SH
	bool "SHARP MMC use qos with timeout customized"
	depends on MMC_CUST_SH
	default n

if MMC

source "drivers/mmc/core/Kconfig"

source "drivers/mmc/card/Kconfig"

source "drivers/mmc/host/Kconfig"

endif # MMC
```

## drivers/sharp/Kconfig
```kconfig
#
# SHARP configuration
#

menu "SHARP Device Drivers"

source "drivers/sharp/shdiag/Kconfig"
source "drivers/sharp/shdisp/Kconfig"
source "drivers/sharp/mfc/Kconfig"
source "drivers/sharp/shmds/Kconfig"

#CONFIG_SH_AUDIO_DRIVER-> 06-007
source "drivers/sharp/shaudio/Kconfig"
#CONFIG_SH_AUDIO_DRIVER<- 06-007

source "drivers/sharp/proximity/Kconfig"
source "drivers/sharp/shtps/Kconfig"
source "drivers/sharp/shirda/Kconfig"
source "drivers/sharp/shcamled/Kconfig"
endmenu
```

## drivers/sharp/shaudio/Kconfig
```kconfig
#
# audio device configuration
#
# CONFIG_SH_AUDIO_DRIVER newly created

menu "SHARP audio driver"

comment "SHARP audio drivers"

config SH_AUDIO_DRIVER_MODEL_NUMBER
        int "SH_AUDIO_DRIVER_MODEL_NUMBER"
        range 0 999
        default "0"

config SH_AUDIO_DRIVER
	tristate "SHARP Audio Driver customized"
	default y

config SHSPAMP_YDA168B
	tristate "SHARP spamp yda168b"
	default n

endmenu
```

## drivers/sharp/shmds/Kconfig
```kconfig
menuconfig SHMDS
	bool "Motion Sensor Drivers"
	default y

if SHMDS
#source "drivers/sharp/shmds/mpu3050/Kconfig"
#source "drivers/sharp/shmds/ami603/Kconfig"
# SHMDS_ID_0101_06 mod S
#source "drivers/sharp/shmds/mpu9150/Kconfig"
source "drivers/sharp/shmds/mpu6515/Kconfig"
# SHMDS_ID_0101_06 mod E

# SHMDS_ID_0101_03 add S
# SHMDS_ID_0101_06 mod S
#source "drivers/sharp/shmds/mpu9150/inv_test/Kconfig"
source "drivers/sharp/shmds/mpu6515/inv_test/Kconfig"
# SHMDS_ID_0101_06 mod E
# SHMDS_ID_0101_03 add E

endif
```

## drivers/sharp/shmds/mpu6515/Kconfig
```kconfig
#
# inv-mpu-iio driver for Invensense MPU devices and combos
#
# SHMDS_ID_0102_01 mod S
# config INV_MPU_IIO
# SHMDS_ID_0102_03 mod S
#config MPU_SENSORS_MPU9150
config MPU_SENSORS_MPU6515
# SHMDS_ID_0102_03 mod S
# SHMDS_ID_0102_01 mod E
	tristate "Invensense MPU devices"
	depends on I2C && SYSFS && IIO && IIO_KFIFO_BUF && IIO_TRIGGER && !INV_MPU
	default n
	help
	  This driver supports the Invensense MPU devices.
	  This includes MPU6050/MPU3050/MPU9150/ITG3500/MPU6500/MPU9250.
	  This driver can be built as a module. The module will be called
	  inv-mpu-iio.

config INV_IIO_MPU3050_ACCEL_SLAVE_BMA250
	bool  "Invensense MPU3050 slave accelerometer device for bma250"
# SHMDS_ID_0102_01 mod S
#	depends on INV_MPU_IIO
# SHMDS_ID_0102_03 mod S
#	depends on MPU_SENSORS_MPU9150
	depends on MPU_SENSORS_MPU6515
# SHMDS_ID_0102_03 mod E
# SHMDS_ID_0102_01 mod E
	default n
	help
	  This is slave device enable MPU3050 accelerometer slave device.
	  Right now, it is only bma250. For other acceleromter device,
	  it can be added to this menu if the proper interface is filled.
	  There are some interface function to be defined.

config DTS_INV_MPU_IIO
	bool  "Invensense MPU driver using Device Tree Structure (DTS)"
# SHMDS_ID_0102_01 mod S
#	depends on INV_MPU_IIO
	depends on MPU_SENSORS_MPU6515
# SHMDS_ID_0102_01 mod E
	default n
	help
	  This enables Invensense MPU devices to use Device Tree Structure.
	  DTS must be enabled in the system.
```

## drivers/sharp/shmds/mpu6515/inv_test/Kconfig
```kconfig
#
# Kconfig for Invensense IIO testing hooks
#

config INV_TESTING
    boolean "Invensense IIO testing hooks"
# SHMDS_ID_0102_01 mod S
#	depends on INV_MPU_IIO || INV_AMI306_IIO || INV_YAS530 || INV_HUB_IIO
#	depends on MPU_SENSORS_MPU9150 || INV_AMI306_IIO || INV_YAS530 || INV_HUB_IIO
	depends on MPU_SENSORS_MPU6515 || INV_AMI306_IIO || INV_YAS530 || INV_HUB_IIO
# SHMDS_ID_0102_01 mod E
    default n
    help
      This flag enables display of additional testing information from the
      Invensense IIO drivers.
      It also enables the I2C counters facility to perform IO profiling.
      Some additional sysfs entries will appear when this flag is enabled.
```

## drivers/sharp/shtps/sy3000/Kconfig
```kconfig
#
# Sharp Touchscreen configuration
#

if TOUCHSCREEN_SHTPS

	config SHTPS_SY3X00_DEV
		tristate "SY3x00 Device"
		default n
		depends on TOUCHSCREEN_SHTPS

	config SHTPS_SY3000_TM2945_001
		tristate "SY3000 TM2945-001"
		default n
		depends on SHTPS_SY3X00_DEV

	config SHTPS_SY3000_TM2955_001
		tristate "SY3000 TM2955-001"
		default n
		depends on SHTPS_SY3X00_DEV

	config SHTPS_SY3000_TM2974_001
		tristate "SY3000 TM2974-001"
		default n
		depends on SHTPS_SY3X00_DEV

	config SHTPS_SY3000_TM2979_001
		tristate "SY3000 TM2979-001"
		default n
		depends on SHTPS_SY3X00_DEV

endif # TOUCHSCREEN_SHTPS
```
